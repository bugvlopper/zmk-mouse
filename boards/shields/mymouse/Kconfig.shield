## config/west.yml
```yaml
manifest:
  remotes:
    - name: zmkfirmware
      url-base: https://github.com/zmkfirmware
    - name: badjeff
      url-base: https://github.com/badjeff
  projects:
    - name: zmk
      remote: zmkfirmware
      revision: v0.2
      import: app/manifest/west.yml
    - name: zmk-paw3395-driver
      remote: badjeff
      revision: main
  self:
    path: config
```
